/*
 * Copyright (C) 2013 Paul Koning
 *
 * Quad RS232 converter cape
 *
 * This program is free software; you can redistribute it and/or modify
 * it under the terms of the GNU General Public License version 2 as
 * published by the Free Software Foundation.
 */
/dts-v1/;
/plugin/;

/ {
	compatible = "ti,beaglebone", "ti,beaglebone-black";

	/* identification */
	part-number = "quad_rs232";
	version = "00A0";

	/* state the resources this cape uses */
	exclusive-use =
		/* the pin header uses */
		"P9.24",	/* uart1_txd */
		"P9.26",	/* uart1_rxd */
		/* the hardware ip uses */
		"uart1",
		/* the pin header uses */
		"P9.21",	/* uart2_txd */
		"P9.22",	/* uart2_rxd */
		/* the hardware ip uses */
		"uart2",
		/* the pin header uses */
		"P9.13",	/* uart4_txd */
		"P9.11",	/* uart4_rxd */
		/* the hardware ip uses */
		"uart4",
		/* the pin header uses */
		"P8.37",	/* uart5_txd */
		"P8.38",	/* uart5_rxd */
		/* the hardware ip uses */
		"uart5";

	fragment@0 {
		target = <&am33xx_pinmux>;
		__overlay__ {
			bb_uart1_pins: pinmux_bb_uart1_pins {
				pinctrl-single,pins = <
					0x184 0x20 /* P9.24 uart1_txd.uart1_txd  OUTPUT  */
					0x180 0x20 /* P9.26 uart1_rxd.uart1_rxd  INPUT  */
					0x150 0x21	/* spi0_sclk.uart2_rxd | MODE1 */
					0x154 0x01	/* spi0_d0.uart2_txd | MODE1 */
					0x070 0x26	/* gpmc_wait0.uart4_rxd | MODE6 */
					0x074 0x06	/* gpmc_wpn.uart4_txd | MODE6 */
					0x0C4 0x24	/* lcd_data9.uart5_rxd | MODE4 */
					0x0C0 0x04	/* lcd_data8.uart5_txd | MODE4 */
				>;
			};
		};
	};
	fragment@1 {
		target = <&uart2>;	/* really uart1 */
		__overlay__ {
			status = "okay";
			pinctrl-names = "default";
			pinctrl-0 = <&bb_uart1_pins>;
		};
	};
};
